## CMakeLists.txt
```
cmake_minimum_required(VERSION 3.20.0)

set(CODECHECKER_ANALYZE_OPTS
    "--config;${CMAKE_SOURCE_DIR}/config/codechecker.yml;"
    "--skip;${CMAKE_SOURCE_DIR}/config/skip.codechecker"
    CACHE STRING "Code checker options")
set(CODECHECKER_EXPORT "html" CACHE STRING "Format of a generated report")

find_package(Zephyr-sdk REQUIRED)
find_package(Zephyr REQUIRED)
project(my_zephyr_app)

target_sources(app
    PRIVATE
        src/main.cpp
        src/worker.cpp
)
```

## west.yml
```
manifest:
  remotes:
    - name: zephyrproject-rtos
      url-base: https://github.com/zephyrproject-rtos

  projects:
    - name: zephyr
      remote: zephyrproject-rtos
      revision: v3.6.0
      import:
        name-allowlist:
          - cmsis      # required by the ARM port
```

## prj.conf
```kconfig
CONFIG_LOG=y
CONFIG_CPP=y
CONFIG_REQUIRES_FULL_LIBCPP=y
CONFIG_DEBUG_OPTIMIZATIONS=y
CONFIG_STD_CPP20=y
```

## src/main.cpp
```c
#include "worker.hh"

int main(void)
{
    while (1) blink_led();

    return 0;
}
```

## src/worker.cpp
```c
#include "worker.hh"

#include <zephyr/kernel.h>

#define SLEEP_TIME_MS 1000

void blink_led()
{
    static bool led_state = true;

    led_state = !led_state;
    printf("LED state: %s\n", led_state ? "ON" : "OFF");
    k_msleep(SLEEP_TIME_MS);
}
```
